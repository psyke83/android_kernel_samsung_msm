## drivers/param/Kconfig
```kconfig
config MSM_PARAM
	tristate "Samsung Paramter Block system"
	depends on ARCH_MSM7X27
	default	m
	help
	  Samsung Android Phone - Parameter control driver
	  samsung_flash.o
```

## drivers/staging/ramzswap_legacy/Kconfig
```kconfig
config RAMZSWAP_LEGACY
	tristate "Compressed swap 0.6.2 legacy (ramzswap)"
	depends on SWAP && CRYPTO_LZO && !ZRAM
	default n
	---help---
	  This will build the compressed swap 0.6.2 (ramzswap) module
```

## fs/rfs/Kconfig
```kconfig
menu "RFS Filesystem"

config RFS_FS
	tristate "RFS Filesystem support"
	default m
	select NLS
	help	
	Samsung Transactional File System support.

config RFS_DEFAULT_IOCHARSET
	string "Use default iocharset"
	default "cp437"
	depends on RFS_FS
	help
	The default input/output character set.

	Character set to use for converting between the encoding is
	used for user visible filename and 16 bit Unicode characters (for NativeFS).

	If you want to use another character set instead of the default,
	you should set the mount option "iocharset=<name>"
	such as "iocharset=iso8859-1".


config RFS_FS_XATTR
	bool "RFS extended attributes"
	default y
	depends on RFS_FS
	help
	Extended attributes are name:value pairs associated with inodes
	by the kernel or by users (see the attr(5) manual page,
	or visit <http://acl.bestbits.at/> for details).

	If unsure, say N.

	WARN!! This feature is NOT compatible with FAT filesystem
	such as Linux vfat or MS-DOS.

#config RFS_FS_POSIX_ACL
#	bool "RFS POSIX Access Control Lists"
#	default n
#	depends on RFS_FS_XATTR
#	select FS_POSIX_ACL
#	help
#	Posix Access Control Lists (ACLs) support permissions for users and
#	groups beyond the owner/group/world scheme.
#
#	To learn more about Access Control Lists, visit the Posix ACLs for
#	Linux website <http://acl.bestbits.at/>.
#
#	If you don't know what Access Control Lists are, say N

config RFS_FS_SECURITY
	bool "RFS Security Labels"
	default y
	depends on RFS_FS_XATTR
	help
	Security labels support alternative access control models
	implemented by security modules like SELinux.
	This option enables an extended attribute namespace
	for inode security labels in the RFS filesystem.

# support 'MOUNT_FILE_GUID' (uid/gid/permission)
config RFS_FS_PERMISSION
	bool "RFS File Permission"
	default y
	depends on RFS_FS
	help
	Basically, FAT file system does not support user-ID, group-ID.
	However RFS supports user/group ID and its permission (rwx),
	if you select <Y>.
	
	If unsure or compatibility is very important, say N.

	WARN!! This feature is NOT compatible with FAT filesystem
	such as Linux vfat or MS-DOS.

config RFS_FS_SYNC_ON_CLOSE
	bool "Sync-On-Close support"
	default n
	depends on RFS_FS
	help
	close() "flushes" all modified in-core data of the file
	and metadata information associated with the file,
	if you select <Y>.
	The latency of close() could be longer, because it waits for
	the end of write I/O to guarantee data and metadata of the file.
	
#config RFS_FS_DEBUG
#	bool "RFS Debugging Message support"
#	default	y
#	depends on RFS_FS

#config RFS_FS_DEBUG_LEVEL
#	int "RFS debugging verbosity (0 = quiet ... 6 = verbose)"
#	default 1
#	depends on RFS_FS_DEBUG

# support 'MOUNT_ERASE_SECTOR' : call stl_delete
config RFS_FS_ERASE_SECTOR
	bool
	default y
	depends on RFS_FS && RFS_STL_DELETE

# support 'MOUNT_FILE_SPECIAL' : enable symlink, socket, fifo (special file)
config RFS_FS_SPECIAL
	bool
	default y
	depends on RFS_FS

source "fs/rfs/Kconfig.debug"

source fs/rfs/Kconfig.native

endmenu
```

## fs/rfs/Kconfig.debug
```kconfig
comment "RFS debugging options"
	depends on RFS_FS

config RFS_FS_DEBUG
	bool "RFS Debugging Message support"
	default	y
	depends on RFS_FS

menu "Additional RFS debugging messages"
	depends on RFS_FS_DEBUG

choice
	prompt "RFS debugging level"
	default RFS_FS_DEBUG_LEVEL_1

config RFS_FS_DEBUG_LEVEL_0
	bool "Panic Error-0"

config RFS_FS_DEBUG_LEVEL_1
	bool "Critical Error-1"

config RFS_FS_DEBUG_LEVEL_2
	bool "Normal Error-2"

config RFS_FS_DEBUG_LEVEL_3
	bool "System Error-3"

config RFS_FS_DEBUG_LEVEL_4
	bool "Information Message-4"

config RFS_FS_DEBUG_LEVEL_5
	bool "Debugging Message-5"

config RFS_FS_DEBUG_LEVEL_6
	bool "Verbose Message-6"

endchoice

#config RFS_FS_DEBUG_LEVEL
#	int "RFS debugging verbosity (0 = quiet ... 6 = verbose)"
#	default 1
#	range 0 6
#	depends on RFS_FS_DEBUG

config RFS_FS_DEBUG_MSG_VOL
	bool "Volume Layer(superblock operation) message"
	default y
	depends on RFS_FS_DEBUG

config RFS_FS_DEBUG_MSG_VNODE
	bool "Vnode Layer(inode operation) message"
	default y
	depends on RFS_FS_DEBUG

config RFS_FS_DEBUG_MSG_DIR
	bool "Dir Layer(dir inode operation) message"
	default y
	depends on RFS_FS_DEBUG

config RFS_FS_DEBUG_MSG_FILE
	bool "File Layer(file operation) message"
	default y
	depends on RFS_FS_DEBUG

config RFS_FS_DEBUG_MSG_BCACHE
	bool "BCache Layer(block I/O) message"
	default n
	depends on RFS_FS_DEBUG

config RFS_FS_DEBUG_MSG_XATTR
	bool "Xattr operation message"
	default n
	depends on RFS_FS_DEBUG

config RFS_FS_DEBUG_MSG_OAM
	bool "OAM Layer(OS Adaptation layer) message"
	default y
	depends on RFS_FS_DEBUG

config RFS_FS_DEBUG_MSG_DEV
	bool "Logical Device message"
	default y
	depends on RFS_FS_DEBUG

config RFS_FS_DEBUG_MSG_API
	bool "RFS API Layer(VFS Api) message"
	default y
	depends on RFS_FS_DEBUG

config RFS_FS_DEBUG_MSG_CORE
	bool "NativeFS Layer message"
	default y
	depends on RFS_FS_DEBUG

config RFS_FS_DEBUG_MSG_BASE
	bool "Nestle Layer message"
	default y
	depends on RFS_FS_DEBUG

endmenu
```

## fs/rfs/Kconfig.native
```kconfig
menu "RFS Core Filesystems"

# FAT Core Filesystem (BTFS)
config RFS_FS_CORE_FAT
	tristate "FAT Filesystem Support"
	default y
	depends on RFS_FS
	help
	RFS supports the FAT-based filesystem core and transactional filesystem.

# FAT32 support
config RFS_FS_FAT_VFAT
	bool "Support FAT32 & Long File Name"
	default y
	depends on RFS_FS_CORE_FAT
	help
	RFS supports FAT32 and Long File Name

config RFS_FS_FAT_DEBUG_LEVEL
	int "FAT debugging verbosity (0 = quiet ... 6 = verbose)"
	default 1
	range 0 6
	depends on RFS_FS_CORE_FAT && RFS_FS_DEBUG

#config RFS_FS_FAT_HPA
#	bool "RFS Hidden-protected Area support"
#	depends on RFS_FS_CORE_FAT
#	help
#	HPA(Hidden protected Area)

#config RFS_FS_FAT_VERSION
#	string
#	default ""
#	depends on RFS_FS_CORE_FAT

endmenu
```
